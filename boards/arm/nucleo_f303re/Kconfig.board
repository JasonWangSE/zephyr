## boards/arm/nucleo_f303re/Kconfig.board
```kconfig
# Kconfig - STM32 Nucleo-64 development board with STM32F303RE MCU configuration
#
# Copyright (c) 2016 RnDity Sp. z o.o.
#
# SPDX-License-Identifier: Apache-2.0
#

config BOARD_NUCLEO_F303RE
	bool "NUCLEO-64 F303RE Development Board"
	depends on SOC_STM32F303XE
```

## boards/arm/nucleo_f303re/Kconfig.defconfig
```kconfig
# Kconfig - STM32 Nucleo-64 development board with STM32F334R8 MCU
#
# Copyright (c) 2016 RnDity Sp. z o.o.
#
# SPDX-License-Identifier: Apache-2.0
#

if BOARD_NUCLEO_F303RE

config BOARD
	default nucleo_f303re

if UART_CONSOLE

config UART_STM32_PORT_2
	default y

endif # UART_CONSOLE

endif # BOARD_NUCLEO_F303RE
```
